## app/boards/l5_task1/Kconfig.l5_task1
```kconfig
# Copyright (c) 2025 Michal Piekos
# SPDX-License-Identifier: Apache-2.0

config BOARD_L5_TASK1
	select SOC_STM32U585XX
```

## app/boards/l5_task1/board.yml
```yaml
board:
  name: l5_task1
  full_name: Black Pill STM32U585
  vendor: l4task1
  socs:
    - name: stm32u585xx
```

## app/boards/l5_task2/board.yml
```yaml
board:
  name: l5_task2
  full_name: Black Pill STM32U585
  vendor: l5task2
  socs:
    - name: stm32u585xx
```

## tests/ring_buf/testcase.yaml
```yaml
common:
  tags:
    - unit
    - ring_buf
    - ztest
    - homework

tests:
  homework.unit.ring_buf:
    platform_allow: 
     - native_sim
     - qemu_x86
     - blackpill_u585ci/stm32u585xx
    timeout: 600
```
